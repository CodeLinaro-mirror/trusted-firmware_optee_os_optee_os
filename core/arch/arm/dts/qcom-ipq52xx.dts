// SPDX-License-Identifier: ISC
/*
 * Copyright (c) Qualcomm Technologies, Inc. and/or its subsidiaries.
 */

/dts-v1/;
/ {
	compatible = "qcom,ipq52xx";
	#address-cells = <1>;
	#size-cells = <1>;

	/* TME Authentication */
	tme_auth: tme-auth {
		compatible = "qcom,tme-auth";
		qcom,tme-auth-version = <1>; /* TME auth V1 for IPQ52xx */
		status = "okay";
	};
};
